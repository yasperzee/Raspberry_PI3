## meta-zee/conf/layer.conf
```bitbake
# v0.2  yasperzee   2'20    YP3.0 - ZEUS Migrate
# v0.1  yasperzee   5'19    YP2.7 - WARRIOR Migrate

# We have a conf and classes directory, add to BBPATH
BBPATH .= ":${LAYERDIR}"

# We have recipes-* directories, add to BBFILES
BBFILES += "${LAYERDIR}/recipes-*/*/*.bb \
	${LAYERDIR}/recipes-*/*/*.bbappend"

BBFILE_COLLECTIONS += "yasperzee"
BBFILE_PATTERN_yasperzee = "^${LAYERDIR}/"
BBFILE_PRIORITY_yasperzee = "6"

LAYERSERIES_COMPAT_yasperzee = "zeus"
```
